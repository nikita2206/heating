## arduino_gateway/sdkconfig.defaults
```kconfig
# Arduino configuration
CONFIG_AUTOSTART_ARDUINO=n

# Serial flasher config
CONFIG_ESPTOOLPY_FLASHSIZE_4MB=y

# Partition Table
CONFIG_PARTITION_TABLE_CUSTOM=y
CONFIG_PARTITION_TABLE_CUSTOM_FILENAME="partitions.csv"

# FreeRTOS
CONFIG_FREERTOS_HZ=1000

# Compiler options
CONFIG_COMPILER_CXX_EXCEPTIONS=y

# Increase main task stack size for Arduino compatibility
CONFIG_ESP_MAIN_TASK_STACK_SIZE=8192

# ESP32 specific
CONFIG_ESP_DEFAULT_CPU_FREQ_MHZ_240=y
```

## components/opentherm/Kconfig
```kconfig
menu "OpenTherm Implementation"

    choice OPENTHERM_IMPL
        prompt "OpenTherm Backend Implementation"
        default OPENTHERM_IMPL_RMT
        help
            Select which OpenTherm implementation to use.
            
            - RMT: Uses ESP32's RMT peripheral for hardware-timed encoding/decoding
            - Library: Uses the Arduino-based opentherm_library (ihormelnyk)

        config OPENTHERM_IMPL_RMT
            bool "RMT (Hardware-based)"
            help
                Use the RMT peripheral-based implementation.
                Provides hardware-timed pulse generation and automatic edge timestamping.

        config OPENTHERM_IMPL_LIBRARY
            bool "Arduino Library"
            help
                Use the Arduino-based opentherm_library implementation.
                Requires Arduino framework as a dependency.
    endchoice

endmenu
```

## main/Kconfig.projbuild
```kconfig
menu "OpenTherm Gateway Configuration"

    config ESP_WIFI_SSID
        string "WiFi SSID"
        default "myssid"
        help
            SSID (network name) for the gateway to connect to.

    config ESP_WIFI_PASSWORD
        string "WiFi Password"
        default "mypassword"
        help
            WiFi password (WPA or WPA2) for the gateway to use.

    config OT_MASTER_IN_PIN
        int "OpenTherm Master IN Pin (from thermostat)"
        default 4
        help
            GPIO pin number for receiving data from thermostat.

    config OT_MASTER_OUT_PIN
        int "OpenTherm Master OUT Pin (to thermostat)"
        default 5
        help
            GPIO pin number for sending data to thermostat.

    config OT_SLAVE_IN_PIN
        int "OpenTherm Slave IN Pin (from boiler)"
        default 18
        help
            GPIO pin number for receiving data from boiler.

    config OT_SLAVE_OUT_PIN
        int "OpenTherm Slave OUT Pin (to boiler)"
        default 19
        help
            GPIO pin number for sending data to boiler.

    menu "MQTT Overrides"
        config OT_MQTT_ENABLE
            bool "Enable MQTT bridge for overrides"
            default y
            help
                Enable MQTT client that listens for external overrides (TSet, CH enable).

        config OT_MQTT_BROKER_URI
            string "MQTT broker URI"
            default "mqtt://192.168.1.10"
            depends on OT_MQTT_ENABLE
            help
                URI of the MQTT broker, e.g. mqtt://192.168.1.10 or mqtts://broker:8883

        config OT_MQTT_CLIENT_ID
            string "MQTT client ID"
            default "ot-gateway"
            depends on OT_MQTT_ENABLE
            help
                Optional client ID for MQTT connection.

        config OT_MQTT_USERNAME
            string "MQTT username"
            default ""
            depends on OT_MQTT_ENABLE
            help
                Username for MQTT authentication (optional).

        config OT_MQTT_PASSWORD
            string "MQTT password"
            default ""
            depends on OT_MQTT_ENABLE
            help
                Password for MQTT authentication (optional).

        config OT_MQTT_BASE_TOPIC
            string "MQTT base topic"
            default "ot_gateway"
            depends on OT_MQTT_ENABLE
            help
                Base topic prefix. Commands are listened on <base>/tset/set and <base>/ch_enable/set.
    endmenu

endmenu
```

## sdkconfig.defaults
```kconfig
#
# Partition Table
#
CONFIG_PARTITION_TABLE_CUSTOM=y
CONFIG_PARTITION_TABLE_CUSTOM_FILENAME="partitions.csv"

#
# Flash Configuration
#
CONFIG_ESPTOOLPY_FLASHSIZE_4MB=y

#
# OTA Configuration
#
CONFIG_BOOTLOADER_APP_ROLLBACK_ENABLE=y

#
# WiFi Configuration
#
CONFIG_ESP_WIFI_SSID="pomestye"
CONFIG_ESP_WIFI_PASSWORD="cMepTbMycopaM"

#
# ESP System Settings
#
CONFIG_ESP_SYSTEM_EVENT_TASK_STACK_SIZE=4096
CONFIG_ESP_MAIN_TASK_STACK_SIZE=8192

#
# Console Configuration
#
CONFIG_ESP_CONSOLE_UART_DEFAULT=n
CONFIG_ESP_CONSOLE_USB_SERIAL_JTAG=y

#
# FreeRTOS
#
CONFIG_FREERTOS_HZ=1000

#
# HTTP Server
#
CONFIG_HTTPD_MAX_REQ_HDR_LEN=1024
CONFIG_HTTPD_MAX_URI_LEN=512
CONFIG_HTTPD_WS_SUPPORT=y

#
# Log output
#
CONFIG_LOG_DEFAULT_LEVEL_INFO=y
CONFIG_LOG_MAXIMUM_LEVEL_VERBOSE=y
CONFIG_LOG_MAXIMUM_LEVEL_DEBUG=y
CONFIG_LOG_DEFAULT_LEVEL=4

#
# mbedTLS
#
CONFIG_MBEDTLS_HARDWARE_AES=n
CONFIG_MBEDTLS_HARDWARE_MPI=n
CONFIG_MBEDTLS_HARDWARE_SHA=n
```
